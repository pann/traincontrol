## sw/sdkconfig.defaults
```kconfig
# Target: ESP32-C3-MINI-1-N4 (on traincontrol-shield)
CONFIG_IDF_TARGET="esp32c3"

# Serial flasher
CONFIG_ESPTOOLPY_FLASHSIZE_4MB=y
CONFIG_ESPTOOLPY_FLASHMODE_DIO=y

# USB Serial JTAG console (built-in USB on ESP32-C3)
CONFIG_ESP_CONSOLE_USB_SERIAL_JTAG=y

# WiFi
CONFIG_ESP_WIFI_SSID=""
CONFIG_ESP_WIFI_PASSWORD=""

# FreeRTOS
CONFIG_FREERTOS_HZ=1000

# Log level
CONFIG_LOG_DEFAULT_LEVEL_INFO=y
```

## sw/test/system/sdkconfig.defaults
```kconfig
# Target: ESP32-S3-DevKitC
CONFIG_IDF_TARGET="esp32s3"

# USB CDC/ACM console (built-in USB on DevKitC)
CONFIG_ESP_CONSOLE_USB_SERIAL_JTAG=y

# FreeRTOS
CONFIG_FREERTOS_HZ=1000

# Disable task watchdog for test firmware (avoid resets during manual pauses)
CONFIG_ESP_TASK_WDT_EN=n

# Log level
CONFIG_LOG_DEFAULT_LEVEL_INFO=y
```
